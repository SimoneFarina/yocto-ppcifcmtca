## conf/layer.conf
```bitbake
# We have a conf and classes directory, add to BBPATH
BBPATH .= ":${LAYERDIR}"

# We have recipes-* directories, add to BBFILES
BBFILES += "${LAYERDIR}/recipes-*/*/*.bb \
	${LAYERDIR}/recipes-*/*/*.bbappend"

BBFILE_COLLECTIONS += "ess-ifc1410"
BBFILE_PATTERN_ess-ifc1410 = "^${LAYERDIR}/"
BBFILE_PRIORITY_ess-ifc1410 = "6"
```

## conf/machine/ess-ifc1410-64b-rt.conf
```bitbake
#@TYPE: Machine
#@NAME: ess-ifc1410-64b-rt
#@SOC: t2080
#@DESCRIPTION: Machine support for IOxOS IFC1410 embedding Freescale QorIQ T2080 CPU
#              with ppce6500 core in 64bit mode. (www.esss.se)

#MACHINEOVERRIDES =. "t2:t2080:"
PREFERRED_PROVIDER_virtual/kernel = "linux-yocto-rt"
PREFERRED_VERSION_linux-yocto-rt = "4.10%"
#4.9%
COMPATIBLE_MACHINE_ess-ifc1410-64b-rt = "ess-ifc1410-64b-rt"

BBMASK += "meta-fsl-ppc/recipes-core/udev/eudev_%.bbappend"
BBMASK += "meta-fsl-ppc/recipes-kernel/cryptodev/"
#cryptodev-qoriq-*_%.bb   
BBMASK += "meta-fsl-ppc/recipes-connectivity/openssl/openssl-qoriq_1.0.2h.bb \
 			meta-fsl-ppc/recipes-bsp/u-boot/u-boot-qoriq_2016.01.bb"
#BBMASK += "openembedded-core/meta/recipes-kernel/cryptodev/cryptodev-module_1.8.bb"
#${WORKDIR}/../

require ../meta-fsl-ppc/conf/machine/include/e6500-64b.inc

#KERNEL_DEFCONFIG ?= "${S}/arch/powerpc/configs/corenet64_fmanv3h_smp_defconfig"

SERIAL_CONSOLE = "115200 ttyS0"

MACHINE_DEVICETREE := " \
			ess-ifc1410-64b-rt.dts \
		    ifc1410-pre.dtsi \
		    ifc1410.dtsi \
		    ifc1410.dts \
		    "
#		    ifc1410/ifc1410-pre.dtsi \
#		    ifc1410/ifc1410.dtsi \
#		    ifc1410/ifc1410.dts \
#		    "

#PREFERRED_VERSION_gcc-cross-${TARGET_ARCH} ?= "5.4%"
#PREFERRED_VERSION_cryptodev-module = "1.9%"

IMAGE_BOOT_FILES += "boot.bin ${MACHINE}.dtb"

IMAGE_FSTYPES = "tar.gz"
# cpio.gz.u-boot

PREFERRED_PROVIDER_virtual/bootloader = "u-boot-ifc1410"

UBOOT_CONFIG ??= "sdcard spi nand srio-pcie-boot secure-boot nor"
UBOOT_CONFIG[nor] = "T2080QDS_config"
UBOOT_CONFIG[sdcard] = "T2080QDS_SDCARD_config,,u-boot-with-spl-pbl.bin"
UBOOT_CONFIG[spi] = "T2080QDS_SPIFLASH_config,,u-boot-with-spl-pbl.bin"
UBOOT_CONFIG[nand] = "T2080QDS_NAND_config,,u-boot-with-spl-pbl.bin"
UBOOT_CONFIG[srio-pcie-boot] = "T2080QDS_SRIO_PCIE_BOOT_config"
UBOOT_CONFIG[secure-boot] = "T2080QDS_SECURE_BOOT_config"


JFFS2_ERASEBLOCK = "0x10000"

EXTRA_IMAGEDEPENDS += "fm-ucode rcw hypervisor hv-cfg"
USE_VT ?= "0"

IMAGE_INSTALL_append = " e2fsprogs-mke2fs libstdc++"

# SSH
IMAGE_FEATURES += "ssh-server-openssh dev-pkgs "
```
